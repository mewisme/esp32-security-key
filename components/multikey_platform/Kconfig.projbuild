## components/multikey_platform/Kconfig.projbuild
```kconfig
menu "MultiKeys board and USB identity"

    config MULTIKEY_BUTTON_GPIO
        int "User-presence button GPIO number"
        range -1 48
        default -1
        help
            GPIO connected to the physical user-presence button. There is NO default: the build
            fails while this is -1. A button press is always required for user presence; there is no
            option to skip it.

            GPIO 0 is the standard BOOT button on ESP32-S3 devkits (active low, external pull-up).
            It is a strapping pin: holding it LOW while the chip leaves reset enters the ROM download
            mode. The firmware only reads it as an input after boot and never drives it
            (docs/HARDWARE.md).

            The build rejects pins that cannot work on an N16R8 module: 19/20 (USB), 26-37
            (flash / octal PSRAM). Pins 3, 45 and 46 are strapping pins and need
            MULTIKEY_BUTTON_STRAPPING_ACK.

    config MULTIKEY_BUTTON_ACTIVE_LOW
        bool "Button pulls the pin to GND when pressed"
        default y
        help
            When enabled the internal pull-up is used and a LOW level means pressed.
            When disabled the internal pull-down is used and a HIGH level means pressed.
            GPIO 0 must be active low (the BOOT circuit).

    config MULTIKEY_BUTTON_STRAPPING_ACK
        bool "I understand the chosen button pin (3, 45 or 46) is a strapping pin"
        default n
        help
            Required only for GPIO 3, 45 and 46. Wrong external levels on these pins at reset can
            change JTAG source, flash voltage or boot messages.

    config MULTIKEY_BUTTON_DEBOUNCE_MS
        int "Button debounce time (ms)"
        range 5 200
        default 30

    choice MULTIKEY_LED_TYPE
        prompt "Status LED"
        default MULTIKEY_LED_TYPE_NONE
        help
            The LED is optional. With NONE no LED GPIO is configured or driven and every LED call
            is a no-op. Without an LED nothing signals that the key is waiting for a button press,
            so the host application's own prompt ("touch your security key") is the only hint.

        config MULTIKEY_LED_TYPE_NONE
            bool "No LED"

        config MULTIKEY_LED_TYPE_PLAIN
            bool "Plain LED (single GPIO)"

        config MULTIKEY_LED_TYPE_WS2812
            bool "WS2812 / NeoPixel (single data line)"
    endchoice

    config MULTIKEY_LED_GPIO
        int "Status LED GPIO number (ignored when the LED type is NONE)"
        range -1 48
        default -1
        help
            There is no default pin: the build fails when an LED type is selected and this is -1.

    config MULTIKEY_LED_ACTIVE_LOW
        bool "Plain LED is lit when the pin is LOW"
        depends on MULTIKEY_LED_TYPE_PLAIN
        default n

    config MULTIKEY_LED_BRIGHTNESS
        int "WS2812 status LED brightness (1-15)"
        depends on MULTIKEY_LED_TYPE_WS2812
        range 1 15
        default 3
        help
            Scale of the colour LED (15 is full WS2812 output, which is glaring). Plain LEDs are on/off only.

    config MULTIKEY_UP_TIMEOUT_MS
        int "User-presence wait timeout (ms)"
        range 1000 60000
        default 15000
        help
            How long a request waits for a button press before it fails. Always at least one
            second: user presence cannot be disabled.

    config MULTIKEY_USB_VID
        hex "USB vendor ID (DEVELOPMENT PLACEHOLDER)"
        range 0x0001 0xFFFF
        default 0x303A
        help
            0x303A is Espressif's VID and is only a development placeholder. Do not
            distribute devices using it; obtain your own VID/PID first.

    config MULTIKEY_USB_PID
        hex "USB product ID (DEVELOPMENT PLACEHOLDER)"
        range 0x0001 0xFFFF
        default 0x4002

    config MULTIKEY_USB_MANUFACTURER
        string "USB manufacturer string"
        default "MultiKeys"
        help
            iManufacturer of the USB device. 1..31 printable ASCII characters (the ESP-IDF TinyUSB
            layer converts string descriptors byte-for-byte, so non-ASCII text is not supported).
            Windows and pcsc-lite prefix the smart-card reader name with this string and the host
            tool `multikey` finds the device by "multikey" in the reader name, so keep it containing
            "MultiKeys" unless you always pass --reader.

    config MULTIKEY_USB_PRODUCT_NAME
        string "USB product name (default device name)"
        default "MultiKeys Security Key"
        help
            iProduct and the base of the interface strings. 1..31 printable ASCII characters.
            Used until the user renames the device (MULTIKEY_USB_CUSTOM_NAME_ENABLED), and again
            after `multikey device reset-name`.

    config MULTIKEY_USB_CUSTOM_NAME_ENABLED
        bool "Allow the user to rename the device (stored name overrides the product name)"
        default y
        help
            When enabled, the MKAUTH applet accepts a device name (INS 06; user presence and, once
            enrolled, the MKAUTH PIN required) which is persisted in flash and used for the USB
            product and interface strings at the next enumeration. The name never touches keys,
            credentials, PINs, VID/PID or the AAGUID. When disabled, the name is fixed at build
            time and INS 06 is rejected.

    config MULTIKEY_WEBUSB_LANDING_ENABLED
        bool "Advertise a WebUSB landing page"
        default y
        help
            Adds the WebUSB platform capability to the BOS descriptor and answers the WebUSB GET_URL
            request with MULTIKEY_WEBUSB_LANDING_URL. Chrome-based browsers may then offer a
            notification linking to that page when the key is plugged in. Disable to drop the WebUSB
            capability entirely (the Microsoft OS 2.0 descriptor that binds WinUSB to the CCID
            interface stays).

    config MULTIKEY_WEBUSB_LANDING_URL
        string "WebUSB landing page URL"
        default "https://multikeys.mewis.me"
        depends on MULTIKEY_WEBUSB_LANDING_ENABLED
        help
            Must start with https:// followed by 1..200 printable ASCII characters without spaces
            (percent-encode anything else). WebUSB only supports http/https; http is not accepted here.
            This is only a link shown by the browser: the device does not fetch it and it grants the
            page no access to the key.

    config MULTIKEY_AAGUID
        string "FIDO AAGUID (32 hex digits) (DEVELOPMENT VALUE)"
        default "0a63b9948ba65e749e5a0f894cc35c4d"
        help
            The authenticator model identifier reported in authenticatorGetInfo and in every
            attestation. The default is a UUIDv5 derived from this project's repository URL and is
            for development only: it is not registered with the FIDO Alliance Metadata Service and
            makes no certification claim. A distributed product must generate and own its own AAGUID.
            It deliberately differs from upstream Pico FIDO's AAGUID so the two firmwares are not
            confused. Changing it does not affect existing credentials (it is not part of any key
            derivation) but relying parties that pinned the old value at registration will see a
            different one for new registrations.

    config MULTIKEY_ALLOW_UNSET_PINS_FOR_CI
        bool "Allow unset pins (CI compile checks ONLY, firmware is not usable)"
        default n
        help
            Lets the build succeed with -1 pins so that CI can compile-check the tree.
            Never enable this in a flashable configuration; sdkconfig.prod must not set it.

endmenu

menu "MultiKeys irreversible hardware operations"

    config MULTIKEY_ALLOW_EFUSE_PROVISIONING
        bool "Allow the firmware to burn a random master key (MKEK) into eFuse KEY3/KEY4 on first boot"
        default n
        help
            IRREVERSIBLE. Upstream pico-keys-sdk burns two random 256-bit keys into eFuse key
            blocks KEY3 and KEY4 at first boot and write-protects them. Keep this OFF for development
            boards. When OFF, stored secrets are wrapped with a key derived from the chip serial only
            (obfuscation, not protection) and the board relies on flash encryption instead
            (docs/SECURITY.md). Enable only for a deliberately provisioned production unit.

endmenu

menu "MultiKeys FIDO user verification defaults"

    config MULTIKEY_FIDO_MAKECRED_UV_NOT_REQUIRED
        bool "Advertise makeCredUvNotRqd on devices whose options were never set (touch-only creation)"
        default y
        help
            CTAP 2.1: when a PIN is set, a relying party that does not require user verification may
            still create a NON-discoverable credential with a button press alone, provided the
            authenticator advertises makeCredUvNotRqd. Upstream sets this only after an
            authenticatorReset, so a fresh device never advertised it. This option initialises the
            flag once, on first boot with no stored options (and after a reset). It never sets the UV
            flag, never touches an existing PIN and can be toggled later with authenticatorConfig
            (needs the PIN). Discoverable credentials and any request that asks for UV still need the PIN.

            LIMIT (upstream design, docs/FIDO_UV.md): while a FIDO PIN is set the device key is wrapped
            with the PIN and the firmware reports alwaysUv=true until the PIN was entered in the current
            session, so browsers ask for the PIN anyway. Touch-only use therefore needs a PIN-less key;
            this flag rarely changes what a browser does, it keeps GetInfo in line with the CTAP 2.1
            behaviour the firmware implements (non-discoverable creation needs no UV).

endmenu
```
